AUTOSAR XML (schema 4-2-2)
package /Company/Components
  swc implementation AccelerationPed_e942f831adb17bf2: programming-language=C, sw-version=3.1.1, used-code-generator=Embedded Coder 7.6 (R2021a) 14-Nov-2020, vendor-id=0, behavior=AccelerationPedalPositionSensor_InternalBehavior
    code-descriptors:
      code Code
        artifact-descriptors:
          short-label=autosar_swc_pedal_sensor_c, category=SWSRC
          short-label=autosar_swc_pedal_sensor_h, category=SWHDR
          short-label=autosar_swc_pedal_sensor_private_h, category=SWHDR
          short-label=autosar_swc_pedal_sensor_types_h, category=SWHDR
          short-label=rtwtypes_h, category=SWHDR
    resource consumption RsrcCons_autosar_swc_pedal_sensor
