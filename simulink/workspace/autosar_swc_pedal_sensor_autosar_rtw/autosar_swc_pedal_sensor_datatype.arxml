AUTOSAR XML (schema 4-2-2)
standard types defined: float32, uint16, float64, float32_DataConstr, uint16_DataConstr
package /AUTOSAR_Platform/ImplementationDataTypes
  unit NoUnit: factor-si-to-unit=1, offset-si-to-unit=0
  impl type MyStruct: category=STRUCTURE
    element BP1: implementation-data-type=rt_Array_float32_11
    element Table: implementation-data-type=rt_Array_float32_11
  impl type rt_Array_float32_11: category=ARRAY
    element rt_Array_float32_11: array-size=11, array-size-semantics=FIXED-SIZE, implementation-data-type=float32
package /AUTOSAR_Platform/ImplementationDataTypes/ApplDataTypes
  app type Appl_SetpointPercent_LkupTbl: category=CURVE, sw-calibration-access=READ-WRITE, sw-calprm-axis-set={sw-axis-index=1, category=STD_AXIS, sw-axis-individual={input-variable-type=Float, compu {identical}, sw-max-axis-points=11, sw-min-axis-points=11, range phys -INF..INF}}, compu {identical}, range phys -INF..INF, sw-record-layout=IntCur_f32_f32, value-axis-data-type=Float
  app type Float: category=VALUE, sw-calibration-access=READ-WRITE, compu {identical}, range phys -INF..INF
package /AUTOSAR_Platform/ImplementationDataTypes/ApplDataTypes/RecordLayouts
  sw record layout IntCur_f32_f32: sw-record-layout-group={short-label=IntCur_f32_f32, sw-record-layout-group={short-label=X, category=INDEX_INCR, sw-record-layout-group-axis=1, sw-record-layout-group-index=X, sw-record-layout-group-from=1, sw-record-layout-group-to=-1, sw-record-layout-v={short-label=VALUE, base-type=float64, sw-record-layout-v-axis=1, sw-record-layout-v-prop=VALUE}}, sw-record-layout-group={short-label=Val, category=COLUMN_DIR, sw-record-layout-group-axis=1, sw-record-layout-group-index=X, sw-record-layout-group-from=1, sw-record-layout-group-to=-1, sw-record-layout-v={short-label=Val, base-type=float64, sw-record-layout-v-axis=0, sw-record-layout-v-prop=VALUE, sw-record-layout-v-index=X}}}
package /AUTOSAR_Platform/ImplementationDataTypes/DataTypeMappings
  data type mapping set AccelerationPedalPositionSensorDataTypeMappingsSet
    data-type-maps:
      application-data-type=Appl_SetpointPercent_LkupTbl, implementation-data-type=MyStruct
      application-data-type=Float, implementation-data-type=float32
package /AUTOSAR_Platform/ImplementationDataTypes/Ground
  constant specification SetpointPercent_LkupTbl: value-spec=[0 10 20 30 40 50 60 70 80 90 100] over axis [170 251.5 333 414.5 496 577.5 659 740.5 822 903.5 985]
