AUTOSAR XML (schema 4-2-2)
package /Company/Components
  swc implementation ThrottlePositionMonitor_imp: programming-language=C, sw-version=4.0.1, used-code-generator=Embedded Coder 7.6 (R2021a) 14-Nov-2020, vendor-id=0, behavior=ThrottlePositionMonitor_InternalBehavior
    code-descriptors:
      code Code
        artifact-descriptors:
          short-label=autosar_swc_monitor_c, category=SWSRC
          short-label=autosar_swc_monitor_data_c, category=SWSRC
          short-label=autosar_swc_monitor_h, category=SWHDR
          short-label=autosar_swc_monitor_private_h, category=SWHDR
          short-label=autosar_swc_monitor_types_h, category=SWHDR
          short-label=rtwtypes_h, category=SWHDR
    resource consumption RsrcCons_autosar_swc_monitor
