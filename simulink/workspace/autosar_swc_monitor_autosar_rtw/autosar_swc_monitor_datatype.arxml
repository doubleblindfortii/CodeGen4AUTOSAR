AUTOSAR XML (schema 4-2-2)
standard types defined: float32, uint16, float32_DataConstr, uint16_DataConstr
