AUTOSAR XML (schema 4-2-2)
package /Company/Interfaces
  6 x sender receiver interface:
    APP_HwIO: invalidation-policy{data-element=APP_HwIO/Value, handle-invalid=DONT-INVALIDATE}
      data Value: category=VALUE, type=uint16
    APP_Percent: invalidation-policy{data-element=APP_Percent/Value, handle-invalid=DONT-INVALIDATE}
      data Value: category=VALUE, type=float32
    ThrCmd_HwIO: invalidation-policy{data-element=ThrCmd_HwIO/Value, handle-invalid=DONT-INVALIDATE}
      data Value: category=VALUE, type=uint16
    ThrCmd_Percent: invalidation-policy{data-element=ThrCmd_Percent/Value, handle-invalid=DONT-INVALIDATE}
      data Value: category=VALUE, type=float32
    TPS_HwIO: invalidation-policy{data-element=TPS_HwIO/Value, handle-invalid=DONT-INVALIDATE}
      data Value: category=VALUE, type=uint16
    TPS_Percent: invalidation-policy{data-element=TPS_Percent/Value, handle-invalid=DONT-INVALIDATE}
      data Value: category=VALUE, type=float32
