AUTOSAR XML (schema 4-2-2)
package /Company/Components
  swc implementation ThrottlePositionActuator_imp: programming-language=C, sw-version=3.1.1, used-code-generator=Embedded Coder 7.6 (R2021a) 14-Nov-2020, vendor-id=0, behavior=ThrottlePositionActuator_InternalBehavior
    code-descriptors:
      code Code
        artifact-descriptors:
          short-label=autosar_swc_actuator_c, category=SWSRC
          short-label=autosar_swc_actuator_h, category=SWHDR
          short-label=autosar_swc_actuator_private_h, category=SWHDR
          short-label=autosar_swc_actuator_types_h, category=SWHDR
          short-label=rtwtypes_h, category=SWHDR
    resource consumption RsrcCons_autosar_swc_actuator
