AUTOSAR XML (schema 4-3-1)
package /Timing
  swc timing test_timing: behavior=test_IB
    timing-requirements:
      execution order constraint EOC
        ordered-elements:
          eoc executable entity ref Runnable_1s: executable=Runnable_1s, successor=Runnable_2S
          eoc executable entity ref Runnable_2S: executable=Runnable_2S
