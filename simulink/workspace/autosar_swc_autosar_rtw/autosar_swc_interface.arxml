AUTOSAR XML (schema 4-3-1)
package /Interfaces
  4 x sender receiver interface:
    In1_1s
      data In1_1s: category=VALUE, sw-calibration-access=READ-ONLY, type=Double
      data New: sw-calibration-access=READ-ONLY
    In2_2S
      data In2_2S: category=VALUE, sw-calibration-access=READ-ONLY, type=Double
    Out1
      data Out1: category=VALUE, sw-calibration-access=READ-ONLY, type=Double
    Out2
      data Out2: category=VALUE, sw-calibration-access=READ-ONLY, type=Double
