AUTOSAR XML (schema 4-3-1)
package /Interfaces
  sender receiver interface interface1
    data DE1: category=VALUE, sw-calibration-access=READ-ONLY, type=None
    data DE2: category=VALUE, sw-calibration-access=READ-ONLY, type=None
  sender receiver interface interface2
    4 x data, all with category=VALUE, sw-calibration-access=READ-ONLY, type=None:
      DE_{1..4}
