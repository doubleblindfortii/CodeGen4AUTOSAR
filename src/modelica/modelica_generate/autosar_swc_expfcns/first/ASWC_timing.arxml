AUTOSAR XML (schema 4-3-1)
package /Timing
  swc timing ASWC_timing: behavior=test_IB
    timing-requirements:
      execution order constraint EOC
        ordered-elements:
          eoc executable entity ref Runnable1: executable=Runnable1, successor=Runnable2
          eoc executable entity ref Runnable2: executable=Runnable2, successor=Runnable3
          eoc executable entity ref Runnable3: executable=Runnable3, successor=[Runnable2, Runnable1]
