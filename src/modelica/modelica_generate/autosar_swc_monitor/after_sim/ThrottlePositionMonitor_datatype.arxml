AUTOSAR XML (schema 4-3-1)
standard types defined: Double, float64
package /DataTypes/Constants
  constant specification DefaultInitValue_Double: value-spec=0
  constant specification DefaultInitValu_036fab392deee624: value-spec=[{short-label=DefaultInitValu_d172891e92bde674, constant=DefaultInitValue_Double}, {short-label=DefaultInitValu_2d898f9704c2f030, constant=DefaultInitValue_Double}]
