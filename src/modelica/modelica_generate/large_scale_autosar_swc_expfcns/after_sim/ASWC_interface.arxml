AUTOSAR XML (schema 4-3-1)
package /Interfaces
  212 x sender receiver interface:
    Interface1
      data DE1: category=VALUE, sw-calibration-access=READ-ONLY, type=None
      data DE2: category=VALUE, sw-calibration-access=READ-ONLY, type=None
    Interface2
      4 x data, all with category=VALUE, sw-calibration-access=READ-ONLY, type=None:
        DE_{1..4}
    Interface_4_1
      data element_Interface_4_1_0: category=VALUE, sw-calibration-access=READ-ONLY, type=None
    Interface_4_2
      data element_Interface_4_2_0: category=VALUE, sw-calibration-access=READ-ONLY, type=None
    Interface_5_1
      data element_Interface_5_1_0: category=VALUE, sw-calibration-access=READ-ONLY, type=None
    Interface_5_2
      data element_Interface_5_2_0: category=VALUE, sw-calibration-access=READ-ONLY, type=None
    Interface_6_1
      data element_Interface_6_1_0: category=VALUE, sw-calibration-access=READ-ONLY, type=None
    Interface_6_2
      data element_Interface_6_2_0: category=VALUE, sw-calibration-access=READ-ONLY, type=None
    Interface_7_1
      data element_Interface_7_1_0: category=VALUE, sw-calibration-access=READ-ONLY, type=None
    Interface_7_2
      data element_Interface_7_2_0: category=VALUE, sw-calibration-access=READ-ONLY, type=None
    Interface_8_1
      data element_Interface_8_1_0: category=VALUE, sw-calibration-access=READ-ONLY, type=None
    Interface_8_2
      data element_Interface_8_2_0: category=VALUE, sw-calibration-access=READ-ONLY, type=None
    Interface_9_1
      data element_Interface_9_1_0: category=VALUE, sw-calibration-access=READ-ONLY, type=None
    Interface_9_2
      data element_Interface_9_2_0: category=VALUE, sw-calibration-access=READ-ONLY, type=None
    Interface_10_1
      data element_Interface_10_1_0: category=VALUE, sw-calibration-access=READ-ONLY, type=None
    Interface_10_2
      data element_Interface_10_2_0: category=VALUE, sw-calibration-access=READ-ONLY, type=None
    Interface_11_1
      data element_Interface_11_1_0: category=VALUE, sw-calibration-access=READ-ONLY, type=None
    Interface_11_2
      data element_Interface_11_2_0: category=VALUE, sw-calibration-access=READ-ONLY, type=None
    Interface_12_1
      data element_Interface_12_1_0: category=VALUE, sw-calibration-access=READ-ONLY, type=None
    Interface_12_2
      data element_Interface_12_2_0: category=VALUE, sw-calibration-access=READ-ONLY, type=None
    Interface_13_1
      data element_Interface_13_1_0: category=VALUE, sw-calibration-access=READ-ONLY, type=None
    Interface_13_2
      data element_Interface_13_2_0: category=VALUE, sw-calibration-access=READ-ONLY, type=None
    Interface_14_1
      data element_Interface_14_1_0: category=VALUE, sw-calibration-access=READ-ONLY, type=None
    Interface_14_2
      data element_Interface_14_2_0: category=VALUE, sw-calibration-access=READ-ONLY, type=None
    Interface_15_1
      data element_Interface_15_1_0: category=VALUE, sw-calibration-access=READ-ONLY, type=None
    Interface_15_2
      data element_Interface_15_2_0: category=VALUE, sw-calibration-access=READ-ONLY, type=None
    Interface_16_1
      data element_Interface_16_1_0: category=VALUE, sw-calibration-access=READ-ONLY, type=None
    Interface_16_2
      data element_Interface_16_2_0: category=VALUE, sw-calibration-access=READ-ONLY, type=None
    Interface_17_1
      data element_Interface_17_1_0: category=VALUE, sw-calibration-access=READ-ONLY, type=None
    Interface_17_2
      data element_Interface_17_2_0: category=VALUE, sw-calibration-access=READ-ONLY, type=None
    Interface_18_1
      data element_Interface_18_1_0: category=VALUE, sw-calibration-access=READ-ONLY, type=None
    Interface_18_2
      data element_Interface_18_2_0: category=VALUE, sw-calibration-access=READ-ONLY, type=None
    Interface_19_1
      data element_Interface_19_1_0: category=VALUE, sw-calibration-access=READ-ONLY, type=None
    Interface_19_2
      data element_Interface_19_2_0: category=VALUE, sw-calibration-access=READ-ONLY, type=None
    Interface_20_1
      data element_Interface_20_1_0: category=VALUE, sw-calibration-access=READ-ONLY, type=None
    Interface_20_2
      data element_Interface_20_2_0: category=VALUE, sw-calibration-access=READ-ONLY, type=None
    Interface_21_1
      data element_Interface_21_1_0: category=VALUE, sw-calibration-access=READ-ONLY, type=None
    Interface_21_2
      data element_Interface_21_2_0: category=VALUE, sw-calibration-access=READ-ONLY, type=None
    Interface_22_1
      data element_Interface_22_1_0: category=VALUE, sw-calibration-access=READ-ONLY, type=None
    Interface_22_2
      data element_Interface_22_2_0: category=VALUE, sw-calibration-access=READ-ONLY, type=None
    Interface_23_1
      data element_Interface_23_1_0: category=VALUE, sw-calibration-access=READ-ONLY, type=None
    Interface_23_2
      data element_Interface_23_2_0: category=VALUE, sw-calibration-access=READ-ONLY, type=None
    Interface_24_1
      data element_Interface_24_1_0: category=VALUE, sw-calibration-access=READ-ONLY, type=None
    Interface_24_2
      data element_Interface_24_2_0: category=VALUE, sw-calibration-access=READ-ONLY, type=None
    Interface_25_1
      data element_Interface_25_1_0: category=VALUE, sw-calibration-access=READ-ONLY, type=None
    Interface_25_2
      data element_Interface_25_2_0: category=VALUE, sw-calibration-access=READ-ONLY, type=None
    Interface_26_1
      data element_Interface_26_1_0: category=VALUE, sw-calibration-access=READ-ONLY, type=None
    Interface_26_2
      data element_Interface_26_2_0: category=VALUE, sw-calibration-access=READ-ONLY, type=None
    Interface_27_1
      data element_Interface_27_1_0: category=VALUE, sw-calibration-access=READ-ONLY, type=None
    Interface_27_2
      data element_Interface_27_2_0: category=VALUE, sw-calibration-access=READ-ONLY, type=None
    Interface_28_1
      data element_Interface_28_1_0: category=VALUE, sw-calibration-access=READ-ONLY, type=None
    Interface_28_2
      data element_Interface_28_2_0: category=VALUE, sw-calibration-access=READ-ONLY, type=None
    Interface_29_1
      data element_Interface_29_1_0: category=VALUE, sw-calibration-access=READ-ONLY, type=None
    Interface_29_2
      data element_Interface_29_2_0: category=VALUE, sw-calibration-access=READ-ONLY, type=None
    Interface_30_1
      data element_Interface_30_1_0: category=VALUE, sw-calibration-access=READ-ONLY, type=None
    Interface_30_2
      data element_Interface_30_2_0: category=VALUE, sw-calibration-access=READ-ONLY, type=None
    Interface_31_1
      data element_Interface_31_1_0: category=VALUE, sw-calibration-access=READ-ONLY, type=None
    Interface_31_2
      data element_Interface_31_2_0: category=VALUE, sw-calibration-access=READ-ONLY, type=None
    Interface_32_1
      data element_Interface_32_1_0: category=VALUE, sw-calibration-access=READ-ONLY, type=None
    Interface_32_2
      data element_Interface_32_2_0: category=VALUE, sw-calibration-access=READ-ONLY, type=None
    Interface_33_1
      data element_Interface_33_1_0: category=VALUE, sw-calibration-access=READ-ONLY, type=None
    Interface_33_2
      data element_Interface_33_2_0: category=VALUE, sw-calibration-access=READ-ONLY, type=None
    Interface_34_1
      data element_Interface_34_1_0: category=VALUE, sw-calibration-access=READ-ONLY, type=None
    Interface_34_2
      data element_Interface_34_2_0: category=VALUE, sw-calibration-access=READ-ONLY, type=None
    Interface_35_1
      data element_Interface_35_1_0: category=VALUE, sw-calibration-access=READ-ONLY, type=None
    Interface_35_2
      data element_Interface_35_2_0: category=VALUE, sw-calibration-access=READ-ONLY, type=None
    Interface_36_1
      data element_Interface_36_1_0: category=VALUE, sw-calibration-access=READ-ONLY, type=None
    Interface_36_2
      data element_Interface_36_2_0: category=VALUE, sw-calibration-access=READ-ONLY, type=None
    Interface_37_1
      data element_Interface_37_1_0: category=VALUE, sw-calibration-access=READ-ONLY, type=None
    Interface_37_2
      data element_Interface_37_2_0: category=VALUE, sw-calibration-access=READ-ONLY, type=None
    Interface_38_1
      data element_Interface_38_1_0: category=VALUE, sw-calibration-access=READ-ONLY, type=None
    Interface_38_2
      data element_Interface_38_2_0: category=VALUE, sw-calibration-access=READ-ONLY, type=None
    Interface_39_1
      data element_Interface_39_1_0: category=VALUE, sw-calibration-access=READ-ONLY, type=None
    Interface_39_2
      data element_Interface_39_2_0: category=VALUE, sw-calibration-access=READ-ONLY, type=None
    Interface_40_1
      data element_Interface_40_1_0: category=VALUE, sw-calibration-access=READ-ONLY, type=None
    Interface_40_2
      data element_Interface_40_2_0: category=VALUE, sw-calibration-access=READ-ONLY, type=None
    Interface_41_1
      data element_Interface_41_1_0: category=VALUE, sw-calibration-access=READ-ONLY, type=None
    Interface_41_2
      data element_Interface_41_2_0: category=VALUE, sw-calibration-access=READ-ONLY, type=None
    Interface_42_1
      data element_Interface_42_1_0: category=VALUE, sw-calibration-access=READ-ONLY, type=None
    Interface_42_2
      data element_Interface_42_2_0: category=VALUE, sw-calibration-access=READ-ONLY, type=None
    Interface_43_1
      data element_Interface_43_1_0: category=VALUE, sw-calibration-access=READ-ONLY, type=None
    Interface_43_2
      data element_Interface_43_2_0: category=VALUE, sw-calibration-access=READ-ONLY, type=None
    Interface_44_1
      data element_Interface_44_1_0: category=VALUE, sw-calibration-access=READ-ONLY, type=None
    Interface_44_2
      data element_Interface_44_2_0: category=VALUE, sw-calibration-access=READ-ONLY, type=None
    Interface_45_1
      data element_Interface_45_1_0: category=VALUE, sw-calibration-access=READ-ONLY, type=None
    Interface_45_2
      data element_Interface_45_2_0: category=VALUE, sw-calibration-access=READ-ONLY, type=None
    Interface_46_1
      data element_Interface_46_1_0: category=VALUE, sw-calibration-access=READ-ONLY, type=None
    Interface_46_2
      data element_Interface_46_2_0: category=VALUE, sw-calibration-access=READ-ONLY, type=None
    Interface_47_1
      data element_Interface_47_1_0: category=VALUE, sw-calibration-access=READ-ONLY, type=None
    Interface_47_2
      data element_Interface_47_2_0: category=VALUE, sw-calibration-access=READ-ONLY, type=None
    Interface_48_1
      data element_Interface_48_1_0: category=VALUE, sw-calibration-access=READ-ONLY, type=None
    Interface_48_2
      data element_Interface_48_2_0: category=VALUE, sw-calibration-access=READ-ONLY, type=None
    Interface_49_1
      data element_Interface_49_1_0: category=VALUE, sw-calibration-access=READ-ONLY, type=None
    Interface_49_2
      data element_Interface_49_2_0: category=VALUE, sw-calibration-access=READ-ONLY, type=None
    Interface_50_1
      data element_Interface_50_1_0: category=VALUE, sw-calibration-access=READ-ONLY, type=None
    Interface_50_2
      data element_Interface_50_2_0: category=VALUE, sw-calibration-access=READ-ONLY, type=None
    Interface_51_1
      data element_Interface_51_1_0: category=VALUE, sw-calibration-access=READ-ONLY, type=None
    Interface_51_2
      data element_Interface_51_2_0: category=VALUE, sw-calibration-access=READ-ONLY, type=None
    Interface_52_1
      data element_Interface_52_1_0: category=VALUE, sw-calibration-access=READ-ONLY, type=None
    Interface_52_2
      data element_Interface_52_2_0: category=VALUE, sw-calibration-access=READ-ONLY, type=None
    Interface_53_1
      data element_Interface_53_1_0: category=VALUE, sw-calibration-access=READ-ONLY, type=None
    Interface_53_2
      data element_Interface_53_2_0: category=VALUE, sw-calibration-access=READ-ONLY, type=None
    Interface_54_1
      data element_Interface_54_1_0: category=VALUE, sw-calibration-access=READ-ONLY, type=None
    Interface_54_2
      data element_Interface_54_2_0: category=VALUE, sw-calibration-access=READ-ONLY, type=None
    Interface_55_1
      data element_Interface_55_1_0: category=VALUE, sw-calibration-access=READ-ONLY, type=None
    Interface_55_2
      data element_Interface_55_2_0: category=VALUE, sw-calibration-access=READ-ONLY, type=None
    Interface_56_1
      data element_Interface_56_1_0: category=VALUE, sw-calibration-access=READ-ONLY, type=None
    Interface_56_2
      data element_Interface_56_2_0: category=VALUE, sw-calibration-access=READ-ONLY, type=None
    Interface_57_1
      data element_Interface_57_1_0: category=VALUE, sw-calibration-access=READ-ONLY, type=None
    Interface_57_2
      data element_Interface_57_2_0: category=VALUE, sw-calibration-access=READ-ONLY, type=None
    Interface_58_1
      data element_Interface_58_1_0: category=VALUE, sw-calibration-access=READ-ONLY, type=None
    Interface_58_2
      data element_Interface_58_2_0: category=VALUE, sw-calibration-access=READ-ONLY, type=None
    Interface_59_1
      data element_Interface_59_1_0: category=VALUE, sw-calibration-access=READ-ONLY, type=None
    Interface_59_2
      data element_Interface_59_2_0: category=VALUE, sw-calibration-access=READ-ONLY, type=None
    Interface_60_1
      data element_Interface_60_1_0: category=VALUE, sw-calibration-access=READ-ONLY, type=None
    Interface_60_2
      data element_Interface_60_2_0: category=VALUE, sw-calibration-access=READ-ONLY, type=None
    Interface_61_1
      data element_Interface_61_1_0: category=VALUE, sw-calibration-access=READ-ONLY, type=None
    Interface_61_2
      data element_Interface_61_2_0: category=VALUE, sw-calibration-access=READ-ONLY, type=None
    Interface_62_1
      data element_Interface_62_1_0: category=VALUE, sw-calibration-access=READ-ONLY, type=None
    Interface_62_2
      data element_Interface_62_2_0: category=VALUE, sw-calibration-access=READ-ONLY, type=None
    Interface_63_1
      data element_Interface_63_1_0: category=VALUE, sw-calibration-access=READ-ONLY, type=None
    Interface_63_2
      data element_Interface_63_2_0: category=VALUE, sw-calibration-access=READ-ONLY, type=None
    Interface_64_1
      data element_Interface_64_1_0: category=VALUE, sw-calibration-access=READ-ONLY, type=None
    Interface_64_2
      data element_Interface_64_2_0: category=VALUE, sw-calibration-access=READ-ONLY, type=None
    Interface_65_1
      data element_Interface_65_1_0: category=VALUE, sw-calibration-access=READ-ONLY, type=None
    Interface_65_2
      data element_Interface_65_2_0: category=VALUE, sw-calibration-access=READ-ONLY, type=None
    Interface_66_1
      data element_Interface_66_1_0: category=VALUE, sw-calibration-access=READ-ONLY, type=None
    Interface_66_2
      data element_Interface_66_2_0: category=VALUE, sw-calibration-access=READ-ONLY, type=None
    Interface_67_1
      data element_Interface_67_1_0: category=VALUE, sw-calibration-access=READ-ONLY, type=None
    Interface_67_2
      data element_Interface_67_2_0: category=VALUE, sw-calibration-access=READ-ONLY, type=None
    Interface_68_1
      data element_Interface_68_1_0: category=VALUE, sw-calibration-access=READ-ONLY, type=None
    Interface_68_2
      data element_Interface_68_2_0: category=VALUE, sw-calibration-access=READ-ONLY, type=None
    Interface_69_1
      data element_Interface_69_1_0: category=VALUE, sw-calibration-access=READ-ONLY, type=None
    Interface_69_2
      data element_Interface_69_2_0: category=VALUE, sw-calibration-access=READ-ONLY, type=None
    Interface_70_1
      data element_Interface_70_1_0: category=VALUE, sw-calibration-access=READ-ONLY, type=None
    Interface_70_2
      data element_Interface_70_2_0: category=VALUE, sw-calibration-access=READ-ONLY, type=None
    Interface_71_1
      data element_Interface_71_1_0: category=VALUE, sw-calibration-access=READ-ONLY, type=None
    Interface_71_2
      data element_Interface_71_2_0: category=VALUE, sw-calibration-access=READ-ONLY, type=None
    Interface_72_1
      data element_Interface_72_1_0: category=VALUE, sw-calibration-access=READ-ONLY, type=None
    Interface_72_2
      data element_Interface_72_2_0: category=VALUE, sw-calibration-access=READ-ONLY, type=None
    Interface_73_1
      data element_Interface_73_1_0: category=VALUE, sw-calibration-access=READ-ONLY, type=None
    Interface_73_2
      data element_Interface_73_2_0: category=VALUE, sw-calibration-access=READ-ONLY, type=None
    Interface_74_1
      data element_Interface_74_1_0: category=VALUE, sw-calibration-access=READ-ONLY, type=None
    Interface_74_2
      data element_Interface_74_2_0: category=VALUE, sw-calibration-access=READ-ONLY, type=None
    Interface_75_1
      data element_Interface_75_1_0: category=VALUE, sw-calibration-access=READ-ONLY, type=None
    Interface_75_2
      data element_Interface_75_2_0: category=VALUE, sw-calibration-access=READ-ONLY, type=None
    Interface_76_1
      data element_Interface_76_1_0: category=VALUE, sw-calibration-access=READ-ONLY, type=None
    Interface_76_2
      data element_Interface_76_2_0: category=VALUE, sw-calibration-access=READ-ONLY, type=None
    Interface_77_1
      data element_Interface_77_1_0: category=VALUE, sw-calibration-access=READ-ONLY, type=None
    Interface_77_2
      data element_Interface_77_2_0: category=VALUE, sw-calibration-access=READ-ONLY, type=None
    Interface_78_1
      data element_Interface_78_1_0: category=VALUE, sw-calibration-access=READ-ONLY, type=None
    Interface_78_2
      data element_Interface_78_2_0: category=VALUE, sw-calibration-access=READ-ONLY, type=None
    Interface_79_1
      data element_Interface_79_1_0: category=VALUE, sw-calibration-access=READ-ONLY, type=None
    Interface_79_2
      data element_Interface_79_2_0: category=VALUE, sw-calibration-access=READ-ONLY, type=None
    Interface_80_1
      data element_Interface_80_1_0: category=VALUE, sw-calibration-access=READ-ONLY, type=None
    Interface_80_2
      data element_Interface_80_2_0: category=VALUE, sw-calibration-access=READ-ONLY, type=None
    Interface_81_1
      data element_Interface_81_1_0: category=VALUE, sw-calibration-access=READ-ONLY, type=None
    Interface_81_2
      data element_Interface_81_2_0: category=VALUE, sw-calibration-access=READ-ONLY, type=None
    Interface_82_1
      data element_Interface_82_1_0: category=VALUE, sw-calibration-access=READ-ONLY, type=None
    Interface_82_2
      data element_Interface_82_2_0: category=VALUE, sw-calibration-access=READ-ONLY, type=None
    Interface_83_1
      data element_Interface_83_1_0: category=VALUE, sw-calibration-access=READ-ONLY, type=None
    Interface_83_2
      data element_Interface_83_2_0: category=VALUE, sw-calibration-access=READ-ONLY, type=None
    Interface_84_1
      data element_Interface_84_1_0: category=VALUE, sw-calibration-access=READ-ONLY, type=None
    Interface_84_2
      data element_Interface_84_2_0: category=VALUE, sw-calibration-access=READ-ONLY, type=None
    Interface_85_1
      data element_Interface_85_1_0: category=VALUE, sw-calibration-access=READ-ONLY, type=None
    Interface_85_2
      data element_Interface_85_2_0: category=VALUE, sw-calibration-access=READ-ONLY, type=None
    Interface_86_1
      data element_Interface_86_1_0: category=VALUE, sw-calibration-access=READ-ONLY, type=None
    Interface_86_2
      data element_Interface_86_2_0: category=VALUE, sw-calibration-access=READ-ONLY, type=None
    Interface_87_1
      data element_Interface_87_1_0: category=VALUE, sw-calibration-access=READ-ONLY, type=None
    Interface_87_2
      data element_Interface_87_2_0: category=VALUE, sw-calibration-access=READ-ONLY, type=None
    Interface_88_1
      data element_Interface_88_1_0: category=VALUE, sw-calibration-access=READ-ONLY, type=None
    Interface_88_2
      data element_Interface_88_2_0: category=VALUE, sw-calibration-access=READ-ONLY, type=None
    Interface_89_1
      data element_Interface_89_1_0: category=VALUE, sw-calibration-access=READ-ONLY, type=None
    Interface_89_2
      data element_Interface_89_2_0: category=VALUE, sw-calibration-access=READ-ONLY, type=None
    Interface_90_1
      data element_Interface_90_1_0: category=VALUE, sw-calibration-access=READ-ONLY, type=None
    Interface_90_2
      data element_Interface_90_2_0: category=VALUE, sw-calibration-access=READ-ONLY, type=None
    Interface_91_1
      data element_Interface_91_1_0: category=VALUE, sw-calibration-access=READ-ONLY, type=None
    Interface_91_2
      data element_Interface_91_2_0: category=VALUE, sw-calibration-access=READ-ONLY, type=None
    Interface_92_1
      data element_Interface_92_1_0: category=VALUE, sw-calibration-access=READ-ONLY, type=None
    Interface_92_2
      data element_Interface_92_2_0: category=VALUE, sw-calibration-access=READ-ONLY, type=None
    Interface_93_1
      data element_Interface_93_1_0: category=VALUE, sw-calibration-access=READ-ONLY, type=None
    Interface_93_2
      data element_Interface_93_2_0: category=VALUE, sw-calibration-access=READ-ONLY, type=None
    Interface_94_1
      data element_Interface_94_1_0: category=VALUE, sw-calibration-access=READ-ONLY, type=None
    Interface_94_2
      data element_Interface_94_2_0: category=VALUE, sw-calibration-access=READ-ONLY, type=None
    Interface_95_1
      data element_Interface_95_1_0: category=VALUE, sw-calibration-access=READ-ONLY, type=None
    Interface_95_2
      data element_Interface_95_2_0: category=VALUE, sw-calibration-access=READ-ONLY, type=None
    Interface_96_1
      data element_Interface_96_1_0: category=VALUE, sw-calibration-access=READ-ONLY, type=None
    Interface_96_2
      data element_Interface_96_2_0: category=VALUE, sw-calibration-access=READ-ONLY, type=None
    Interface_97_1
      data element_Interface_97_1_0: category=VALUE, sw-calibration-access=READ-ONLY, type=None
    Interface_97_2
      data element_Interface_97_2_0: category=VALUE, sw-calibration-access=READ-ONLY, type=None
    Interface_98_1
      data element_Interface_98_1_0: category=VALUE, sw-calibration-access=READ-ONLY, type=None
    Interface_98_2
      data element_Interface_98_2_0: category=VALUE, sw-calibration-access=READ-ONLY, type=None
    Interface_99_1
      data element_Interface_99_1_0: category=VALUE, sw-calibration-access=READ-ONLY, type=None
    Interface_99_2
      data element_Interface_99_2_0: category=VALUE, sw-calibration-access=READ-ONLY, type=None
    Interface_100_1
      data element_Interface_100_1_0: category=VALUE, sw-calibration-access=READ-ONLY, type=None
    Interface_100_2
      data element_Interface_100_2_0: category=VALUE, sw-calibration-access=READ-ONLY, type=None
    Interface_101_1
      data element_Interface_101_1_0: category=VALUE, sw-calibration-access=READ-ONLY, type=None
    Interface_101_2
      data element_Interface_101_2_0: category=VALUE, sw-calibration-access=READ-ONLY, type=None
    Interface_102_1
      data element_Interface_102_1_0: category=VALUE, sw-calibration-access=READ-ONLY, type=None
    Interface_102_2
      data element_Interface_102_2_0: category=VALUE, sw-calibration-access=READ-ONLY, type=None
    Interface_103_1
      data element_Interface_103_1_0: category=VALUE, sw-calibration-access=READ-ONLY, type=None
    Interface_103_2
      data element_Interface_103_2_0: category=VALUE, sw-calibration-access=READ-ONLY, type=None
    Interface_104_1
      data element_Interface_104_1_0: category=VALUE, sw-calibration-access=READ-ONLY, type=None
    Interface_104_2
      data element_Interface_104_2_0: category=VALUE, sw-calibration-access=READ-ONLY, type=None
    Interface_105_1
      data element_Interface_105_1_0: category=VALUE, sw-calibration-access=READ-ONLY, type=None
    Interface_105_2
      data element_Interface_105_2_0: category=VALUE, sw-calibration-access=READ-ONLY, type=None
    Interface_106_1
      data element_Interface_106_1_0: category=VALUE, sw-calibration-access=READ-ONLY, type=None
    Interface_106_2
      data element_Interface_106_2_0: category=VALUE, sw-calibration-access=READ-ONLY, type=None
    Interface_107_1
      data element_Interface_107_1_0: category=VALUE, sw-calibration-access=READ-ONLY, type=None
    Interface_107_2
      data element_Interface_107_2_0: category=VALUE, sw-calibration-access=READ-ONLY, type=None
    Interface_108_1
      data element_Interface_108_1_0: category=VALUE, sw-calibration-access=READ-ONLY, type=None
    Interface_108_2
      data element_Interface_108_2_0: category=VALUE, sw-calibration-access=READ-ONLY, type=None
