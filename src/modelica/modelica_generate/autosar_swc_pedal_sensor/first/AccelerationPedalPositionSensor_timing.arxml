AUTOSAR XML (schema 4-3-1)
package /Timing
  swc timing AccelerationPedalPositionSensor_timing: behavior=test_IB
    timing-requirements:
      execution order constraint EOC
        ordered-elements:
          eoc executable entity ref Runnable_Step: executable=Runnable_Step
