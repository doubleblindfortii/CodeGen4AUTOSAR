AUTOSAR XML (schema 4-3-1)
package /Components/SwcImplementations
  swc implementation SwcImplementations/test_IB: programming-language=C, sw-version=1.27.1, used-code-generator=ARXML Coder Generator 1.0 (Wumbuk) 04-OCT-2023, vendor-id=0, behavior=test_IB
    code-descriptors:
      code Code
        artifact-descriptors:
          short-label=ThrottlePositionSensor_c, category=SWSRC
          short-label=rtwtypes_h, category=SWHDR
          short-label=ThrottlePositionSensor_h, category=SWHDR
    resource consumption RsrcCons_ThrottlePositionSensor
