AUTOSAR XML (schema 4-3-1)
package /Interfaces
  6 x sender receiver interface:
    APP_HwIO
      data Value_1: category=VALUE, sw-calibration-access=NotAccessible, type=None
    APP_Percent
      data Value_2: category=VALUE, sw-calibration-access=NotAccessible, type=None
    ThrCmd_HwIO
      data Value_3: category=VALUE, sw-calibration-access=NotAccessible, type=None
    ThrCmd_Percent
      data Value_4: category=VALUE, sw-calibration-access=NotAccessible, type=None
    TPS_HwIO
      data Value_5: category=VALUE, sw-calibration-access=NotAccessible, type=None
    TPS_Percent
      data Value_6: category=VALUE, sw-calibration-access=NotAccessible, type=None
